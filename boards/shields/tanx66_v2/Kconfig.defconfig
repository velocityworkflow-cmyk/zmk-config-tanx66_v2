## boards/shields/tanx66_v2/Kconfig.defconfig
```kconfig
if SHIELD_TANX66_V2

    config ZMK_KEYBOARD_NAME
      default "tanx66_v2"    

    config USB_DEVICE_PRODUCT
      default "tanx66_v2"

    config BT_DEVICE_NAME
      default "tanx66_v2"

    config I2C
      default y

    config SSD1306
      default y

    config SPI
      default y

    config ZMK_BLE
	    default y

    config ZMK_USB
	    default y 

 endif
```

## boards/shields/tanx66_v2/Kconfig.shield
```kconfig
if SHIELD_TANX66_V2

# Name must be less than 16 characters long!
config ZMK_KEYBOARD_NAME
    default "tanx66_v2"

endif
```
